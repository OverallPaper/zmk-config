## config/boards/shields/tastiera3x3/Kconfig.defconfig
```kconfig
# Kconfig.defconfig
if SHIELD_TASTIERA3X3

config ZMK_KEYBOARD_NAME
    default "Tastiera 3x3"

endif
```

## config/boards/shields/tastiera3x3/kconfig.shield
```kconfig
# Kconfig.shield
config SHIELD_TASTIERA3X3
    def_bool $(shields_list_contains,tastiera3x3)
```
